#include <ESP8266WiFi.h>
#include <ESP8266HTTPClient.h>
#include <ArduinoJson.h>

#define SERVER_IP "192.168.0.45:8006"

#ifndef STASSID
#define STASSID "----"
#define STAPSK "----"
#endif

String serverUrl = "http://" + String(SERVER_IP) + "/submit_temperature";
int myDeviceId = 1;
String myLocation = "esp";


void setup() {

  Serial.begin(9600);

  Serial.println();
  Serial.println();
  Serial.println();

  WiFi.begin(STASSID, STAPSK);

  while (WiFi.status() != WL_CONNECTED) {
    delay(500);
    Serial.print(".");
  }
  Serial.println("");
  Serial.print("Connected! IP address: ");
  Serial.println(WiFi.localIP());

  Serial.println("Enter a number to add the value to the server.");
  Serial.println("'A' and 'a' will display the average.");
}


void loop() {  //This was generated by a neuron

  if (Serial.available() > 0) { // Проверяем, есть ли доступные данные в Serial
    String receivedData = Serial.readString(); // Считываем данные в переменную типа String
    Serial.println("Received data: " + receivedData); // Выводим считанные данные в Serial
    char firstChar = receivedData.charAt(0); // Получаем первый символ из строки

    if (isdigit(firstChar)) { // Проверяем, является ли символ цифрой
      post(receivedData.toFloat());

    } else if (firstChar == 'a' || firstChar == 'A'){
      Serial.println("AVG = " + String(get_AVG(myLocation)));
    }
  }

}

float get_AVG(String location){
  
    WiFiClient client;

    HTTPClient http;

    Serial.print("[HTTP] begin...\n");
    if (http.begin(client, "http://" + String(SERVER_IP) + "/location_data/" + location)) {  // HTTP


      Serial.print("[HTTP] GET...\n");
      int httpCode = http.GET();

      if (httpCode > 0) {
        Serial.printf("[HTTP] GET... code: %d\n", httpCode);

        if (httpCode == HTTP_CODE_OK || httpCode == HTTP_CODE_MOVED_PERMANENTLY) {
          JsonDocument doc;
          String payload = http.getString();
          DeserializationError error = deserializeJson(doc, payload);
          int lenData = doc["len"];
          float data = 0;
          float avg = 0;
          for (int i=0; i<lenData; i++){
            data = doc["data"][i];
            avg += data;
          }
          avg /= lenData;
          Serial.println(payload);
          
          http.end();
          return avg;  
          
        }
      } else {
        Serial.printf("[HTTP] GET... failed, error: %s\n", http.errorToString(httpCode).c_str());
      }
      http.end();
    } else {
      Serial.println("[HTTP] Unable to connect");
    }
    return 0;
}



void post(float value){
  WiFiClient client;
  HTTPClient http;

  Serial.print("[HTTP] begin...\n");
  http.begin(client, serverUrl);
  http.addHeader("Content-Type", "application/json");
  Serial.print("[HTTP] POST...\n");

  JsonDocument doc;
  doc["device_id"] = myDeviceId;
  doc["location"] = myLocation;
  doc["value"] = value;

  String postBody; 
  serializeJson(doc, postBody);

  int httpCode = http.POST(postBody);

  if (httpCode > 0) {
    Serial.printf("[HTTP] POST... code: %d\n", httpCode);

    if (httpCode == HTTP_CODE_OK) {
      const String& payload = http.getString();
      Serial.println("received payload:\n<<");
      Serial.println(payload);
      Serial.println(">>");
    }
  } else {
    Serial.printf("[HTTP] POST... failed, error: %s\n", http.errorToString(httpCode).c_str());
  }

  http.end();
}
